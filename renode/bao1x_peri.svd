# bao1x_peri register map
Vendor: baochip
Registers are 32-bit, read-write, reset 0x0 unless marked. A register's access mark holds for its fields unless they carry their own. Offsets are from the block's base; [hi:lo] are bit positions; {n}, {i} and the like mark numbered series; 'fields as' and 'values as' point back to an identical list; <NAME> marks a mode.

## RRC
Base 0x40000000
0x00 SFR_RRCCR — See `rrc.sv#L261 <https://github.com/baochip/baochip-1x/blob/main/rtl/modules/rr c/rtl/rrc.sv#L261>`__ (line numbers are approximate)
  [31:0] sfr_rrccr — sfr_rrccr read/write control register
0x04 SFR_RRCFD — See `rrc.sv#L262 <https://github.com/baochip/baochip-1x/blob/main/rtl/modules/rr c/rtl/rrc.sv#L262>`__ (line numbers are approximate)
  [4:0] sfr_rrcfd — sfr_rrcfd read/write control register
0x08 SFR_RRCSR — See `rrc.sv#L263 <https://github.com/baochip/baochip-1x/blob/main/rtl/modules/rr c/rtl/rrc.sv#L263>`__ (line numbers are approximate)
  [9:0] sfr_rrcsr — sfr_rrcsr read only status register
0x0C SFR_RRCFR — See `rrc.sv#L264 <https://github.com/baochip/baochip-1x/blob/main/rtl/modules/rr c/rtl/rrc.sv#L264>`__ (line numbers are approximate)
  [4:0] sfr_rrcfr — sfr_rrcfr flag register. `1` means event happened, write back `1` in respective bit position to clear the flag
0x14 SFR_RRCSR_SET0 — See `rrc.sv#L266 <https://github.com/baochip/baochip-1x/blob/main/rtl/modules/rr c/rtl/rrc.sv#L266>`__ (line numbers are approximate)
  [31:0] trc_set_failure — trc_set_failure read only status register
0x18 SFR_RRCSR_SET1 — See `rrc.sv#L267 <https://github.com/baochip/baochip-1x/blob/main/rtl/modules/rr c/rtl/rrc.sv#L267>`__ (line numbers are approximate)
  [31:0] trc_set_failure — trc_set_failure read only status register
0x1C SFR_RRCSR_RST0 — See `rrc.sv#L268 <https://github.com/baochip/baochip-1x/blob/main/rtl/modules/rr c/rtl/rrc.sv#L268>`__ (line numbers are approximate)
  [31:0] trc_reset_failure — trc_reset_failure read only status register
0x20 SFR_RRCSR_RST1 — See `rrc.sv#L269 <https://github.com/baochip/baochip-1x/blob/main/rtl/modules/rr c/rtl/rrc.sv#L269>`__ (line numbers are approximate)
  fields as SFR_RRCSR_RST0
0x24 SFR_RRCSR_RD0 — See `rrc.sv#L270 <https://github.com/baochip/baochip-1x/blob/main/rtl/modules/rr c/rtl/rrc.sv#L270>`__ (line numbers are approximate)
  [31:0] trc_fourth_read_failure — trc_fourth_read_failure read only status register
0x28 SFR_RRCSR_RD1 — See `rrc.sv#L271 <https://github.com/baochip/baochip-1x/blob/main/rtl/modules/rr c/rtl/rrc.sv#L271>`__ (line numbers are approximate)
  fields as SFR_RRCSR_RD0
0xF0 SFR_RRCAR — See `rrc.sv#L273 <https://github.com/baochip/baochip-1x/blob/main/rtl/modules/rr c/rtl/rrc.sv#L273>`__ (line numbers are approximate)
  [31:0] sfr_rrcar — sfr_rrcar performs action on write of value: 0x2468

## GLUECHAIN
Base 0x40054000
0x00 SFR_GCMASK_CR_GCMASK0 — See `gluechain.sv#L44 <https://github.com/baochip/baochip-1x/blob/main/rtl/modul es/sec/rtl/gluechain.sv#L44>`__ (line numbers are approximate)
  [31:0] cr_gcmask0 — cr_gcmask read/write control register
0x04 SFR_GCSR_GLUEREG0 — See `gluechain.sv#L45 <https://github.com/baochip/baochip-1x/blob/main/rtl/modul es/sec/rtl/gluechain.sv#L45>`__ (line numbers are approximate)
  [31:0] gluereg0 — gluereg read only status register
0x08 SFR_GCRST_GLUERST0 — See `gluechain.sv#L46 <https://github.com/baochip/baochip-1x/blob/main/rtl/modul es/sec/rtl/gluechain.sv#L46>`__ (line numbers are approximate)
  [31:0] gluerst0 — gluerst read/write control register
0x0C SFR_GCTEST_GLUETEST0 — See `gluechain.sv#L47 <https://github.com/baochip/baochip-1x/blob/main/rtl/modul es/sec/rtl/gluechain.sv#L47>`__ (line numbers are approximate)
  [31:0] gluetest0 — gluetest read/write control register

## MESH
Base 0x40052000
0x00 SFR_MLDRV_CR_MLDRV0 — See `mesh.sv#L49 <https://github.com/baochip/baochip-1x/blob/main/rtl/modules/se c/rtl/mesh.sv#L49>`__ (line numbers are approximate)
  [31:0] cr_mldrv0 — cr_mldrv read/write control register
0x04 SFR_MLDRV_CR_MLDRV1 — See `mesh.sv#L49 <https://github.com/baochip/baochip-1x/blob/main/rtl/modules/se c/rtl/mesh.sv#L49>`__ (line numbers are approximate)
  [31:0] cr_mldrv1 — cr_mldrv read/write control register
0x10 SFR_MLIE_CR_MLIE0 — See `mesh.sv#L50 <https://github.com/baochip/baochip-1x/blob/main/rtl/modules/se c/rtl/mesh.sv#L50>`__ (line numbers are approximate)
  [31:0] cr_mlie0 — cr_mlie read/write control register
0x14 SFR_MLIE_CR_MLIE1 — See `mesh.sv#L50 <https://github.com/baochip/baochip-1x/blob/main/rtl/modules/se c/rtl/mesh.sv#L50>`__ (line numbers are approximate)
  [31:0] cr_mlie1 — cr_mlie read/write control register
{0x20+4i} SFR_MLSR_SR_MLSR{i} (i=0..7) — See `mesh.sv#L51 <https://github.com/baochip/baochip-1x/blob/main/rtl/modules/se c/rtl/mesh.sv#L51>`__ (line numbers are approximate)
  [31:0] sr_mlsr{i} — sr_mlsr read only status register
